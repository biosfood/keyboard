## config/Kconfig.defconfig
```kconfig
if EISENHAUER_LEFT

config ZMK_KEYBOARD_NAME
    default "EisenhauerKB"

config ZMK_SPLIT_ROLE_CENTRAL
    default y

endif

if EISENHAUER_LEFT || EISENHAUER_RIGHT

config ZMK_SPLIT
    default y

endif
```

## config/boards/shields/eisenhauer/Kconfig.shield
```kconfig
config EISENHAUER_LEFT
    def_bool $(shields_list_contains,eisenhauer_left)

config EISENHAUER_RIGHT
    def_bool $(shields_list_contains,eisenhauer_right)
```
