#include "eisenhauer.dtsi"

&kscan0 {
    col-gpios
        = <&seeeduino_xiao_ble 3 GPIO_ACTIVE_HIGH>
        , <&seeeduino_xiao_ble 4 GPIO_ACTIVE_HIGH>
        , <&seeeduino_xiao_ble 5 GPIO_ACTIVE_HIGH>
        , <&seeeduino_xiao_ble 6 GPIO_ACTIVE_HIGH>
        , <&seeeduino_xiao_ble 7 GPIO_ACTIVE_HIGH>
        , <&seeeduino_xiao_ble 8 GPIO_ACTIVE_HIGH>
        ;
};
